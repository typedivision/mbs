## meta-mbs/conf/distro/mbs.conf
```bitbake
require conf/distro/poky.conf

DISTRO = "mbs"
DISTRO_NAME = "mbs (micro-bot-system)"
DISTRO_VERSION = "${DATE}"

TCLIBC = "musl"

VIRTUAL-RUNTIME_init_manager = "busybox"
DISTRO_FEATURES_BACKFILL_CONSIDERED += "sysvinit"

NO_RECOMMENDATIONS = "1"

DISTRO_FEATURES = ""
DISTRO_FEATURES_NATIVESDK = ""
```

## meta-mbs/conf/layer.conf
```bitbake
# We have a conf and classes directory, add to BBPATH
BBPATH .= ":${LAYERDIR}"

# We have recipes-* directories, add to BBFILES
BBFILES += "${LAYERDIR}/recipes-*/*/*.bb \
            ${LAYERDIR}/recipes-*/*/*.bbappend"

BBFILE_COLLECTIONS += "meta-mbs"
BBFILE_PATTERN_meta-mbs = "^${LAYERDIR}/"
BBFILE_PRIORITY_meta-mbs = "6"

LAYERDEPENDS_meta-mbs = "core"
LAYERSERIES_COMPAT_meta-mbs = "warrior zeus"
```

## meta-mbs/conf/machine/rpi3-64.conf
```bitbake
#@TYPE: Machine
#@NAME: Raspberry Pi 3 64 bit
#@DESCRIPTION: Machine configuration for the Raspberry Pi 3 in 64 bit mode

require conf/machine/include/tune-cortexa53.inc

SOC_FAMILY = "rpi"
include conf/machine/include/soc-family.inc

PREFERRED_PROVIDER_virtual/kernel = "linux-rpi-mbs"

KERNEL_IMAGETYPE = "Image"
KERNEL_DEVICETREE = "broadcom/bcm2710-rpi-3-b.dtb"

SERIAL_CONSOLES ?= "115200;ttyAMA0"

# QEMU config
QB_SYSTEM_NAME = "qemu-system-aarch64"
QB_MACHINE = "-M raspi3"
QB_DTB = "bcm2710-rpi-3-b.dtb"
QB_MEM = "1G"
QB_KERNEL_CMDLINE_APPEND = "console=ttyAMA0"
QB_NET = "none"
QB_OPT_APPEND = ""
```
